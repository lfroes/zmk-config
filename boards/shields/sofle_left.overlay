&display {
    compatible = "solomon,ssd1306fb";
    spi-max-frequency = <10000000>;
    label = "SSD1306";
    height = <32>;
    width = <128>;
    segment-offset = <0>;
    page-offset = <0>;
    display-offset = <0>;
    rotation = <0>;
    status = "okay";
};
